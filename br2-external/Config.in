## br2-external/Config.in
```kconfig
source "$BR2_EXTERNAL_AMBERNIC_PATH/package/cozisboy-splash/Config.in"
source "$BR2_EXTERNAL_AMBERNIC_PATH/package/cozisboy-web/Config.in"
source "$BR2_EXTERNAL_AMBERNIC_PATH/package/mgba/Config.in"
source "$BR2_EXTERNAL_AMBERNIC_PATH/package/cozisboy-ui/Config.in"
```

## br2-external/board/rg35xx-sp/fastboot/fastboot.its
```
/dts-v1/;

/ {
	description = "RG35XX SP fast boot: TF-A + trampoline (as U-Boot) + Linux";
	#address-cells = <1>;

	images {
		atf {
			description = "TF-A BL31";
			data = /incbin/("bl31.bin");
			type = "firmware";
			os = "arm-trusted-firmware";
			arch = "arm64";
			compression = "none";
			load = <0x40000000>;
			entry = <0x40000000>;
		};
		trampoline {
			description = "BL33 trampoline -> Linux";
			data = /incbin/("trampoline.bin");
			type = "firmware";
			os = "u-boot";
			arch = "arm64";
			compression = "none";
			load = <0x4a000000>;
			entry = <0x4a000000>;
		};
		kernel {
			description = "Linux";
			data = /incbin/("Image");
			type = "kernel";
			os = "linux";
			arch = "arm64";
			compression = "none";
			load = <0x40200000>;
			entry = <0x40200000>;
		};
		fdt-1 {
			description = "RG35XX SP device tree";
			data = /incbin/("fastboot.dtb");
			type = "flat_dt";
			arch = "arm64";
			compression = "none";
		};
	};

	configurations {
		default = "config-1";
		config-1 {
			description = "fast boot";
			firmware = "atf";
			loadables = "trampoline", "kernel";
			fdt = "fdt-1";
		};
	};
};
```

## br2-external/package/cozisboy-splash/Config.in
```kconfig
config BR2_PACKAGE_COZISBOY_SPLASH
	bool "cozisboy-splash"
	select BR2_PACKAGE_ALSA_LIB
	help
	  cozisboy animated boot splash (fbdev, static, runs as PID 1 pre-init)
	  and its boot jingle player (cozisboy-chime, alsa-lib).
```

## br2-external/package/cozisboy-ui/Config.in
```kconfig
config BR2_PACKAGE_COZISBOY_UI
	bool "cozisboy-ui"
	select BR2_PACKAGE_ALSA_LIB
	select BR2_PACKAGE_MGBA
	select BR2_PACKAGE_LIBPNG
	depends on BR2_INSTALL_LIBSTDCPP # mgba
	help
	  cozisboy launcher (apps/ui) with its device front end: framebuffer,
	  evdev buttons, ALSA sound, mGBA for games.
```

## br2-external/package/cozisboy-web/Config.in
```kconfig
config BR2_PACKAGE_COZISBOY_WEB
	bool "cozisboy-web"
	select BR2_PACKAGE_LIBCURL
	select BR2_PACKAGE_CA_CERTIFICATES
	help
	  cozisboy web app: manage games, battery saves and save states from a
	  browser (built on the game library in apps/common), plus coz-lib, the
	  library's command-line tool.
```

## br2-external/package/mgba/Config.in
```kconfig
config BR2_PACKAGE_MGBA
	bool "mgba"
	depends on BR2_INSTALL_LIBSTDCPP # cmake checks for a C++ compiler
	help
	  mGBA Game Boy / Game Boy Advance emulator, built as a library
	  (libmgba) for the cozisboy launcher: no frontends, no GL, no
	  scripting.

	  https://mgba.io
```
